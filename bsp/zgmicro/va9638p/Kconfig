## bsp/zgmicro/va9638p/Kconfig
```kconfig
mainmenu "RT-Thread Configuration"

BSP_DIR := .

RTT_DIR := ../../..

PKGS_DIR := packages

config SOC_VA9638P
    bool
    select RT_USING_COMPONENTS_INIT
    select RT_USING_USER_MAIN
    default y

source "$(RTT_DIR)/Kconfig"
osource "$PKGS_DIR/Kconfig"

if !RT_USING_NANO
rsource "board/Kconfig"
endif
```
